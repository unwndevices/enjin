## examples/esp32_sdcard_demo/sdkconfig.defaults
```kconfig
# Target: ESP32-S3
CONFIG_IDF_TARGET="esp32s3"

# Flash: 16MB
CONFIG_ESPTOOLPY_FLASHSIZE_16MB=y

# PSRAM: 8MB octal, 80MHz
CONFIG_SPIRAM=y
CONFIG_SPIRAM_MODE_OCT=y
CONFIG_SPIRAM_SPEED_80M=y
CONFIG_SPIRAM_USE_CAPS_ALLOC=y

# CPU: 240MHz
CONFIG_ESP_DEFAULT_CPU_FREQ_MHZ=240

# Partition table: single app, large
CONFIG_PARTITION_TABLE_SINGLE_APP_LARGE=y

# Stack: 8KB for main task (Lua needs headroom)
CONFIG_ESP_MAIN_TASK_STACK_SIZE=8192
```
